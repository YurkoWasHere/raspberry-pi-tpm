// SPDX-License-Identifier: GPL-2.0+
/*
 * U-Boot control DT only: the TPM on bit-banged SPI, because upstream U-Boot has no
 * BCM2835 SPI controller driver. Pins are the ones the TPM HAT uses on SPI0:
 * GPIO 11 SCLK, 10 MOSI, 9 MISO, 7 CE1. Linux never sees this node; it gets the
 * firmware-built DT from start.elf via ${fdt_addr}, which keeps the real spi0 TPM node.
 */
/ {
	tpm-spi-gpio {
		compatible = "spi-gpio";
		#address-cells = <1>;
		#size-cells = <0>;
		gpio-sck = <&gpio 11 0>;
		gpio-mosi = <&gpio 10 0>;
		gpio-miso = <&gpio 9 0>;
		cs-gpios = <&gpio 7 1>;		/* active low */
		num-chipselects = <1>;
		spi-delay-us = <1>;

		tpm@0 {
			compatible = "infineon,slb9670", "tcg,tpm_tis-spi";
			reg = <0>;
			spi-max-frequency = <1000000>;
		};
	};
};
